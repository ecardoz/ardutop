/********************************************************************
 * Adapted by Edgar Casanova Cardoz - Diciembre 2014
 * http://idun.com.mx
 * email: ecardoz@idun.com.mx
 * twitter: @ecardoz
 * 
 * Ardutop: Arduino System Monitor for Linux
 * 
 ********************************************************************/

#include <SPI.h>
#include <Adafruit_GFX.h>
#include <Adafruit_PCD8544.h>

const unsigned char PROGMEM idun [] = {
  0x0,0x0,0x0,0x0,0x0,0x0,0x0,0x0,0x0,0x0,0x0,
  0x0,0x0,0x0,0x0,0x0,0x0,0x0,0x0,0x0,0x0,0x0,
  0x0,0x0,0x0,0x0,0x0,0x0,0x0,0x0,0x0,0x0,0x0,
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  0x0,0x0,0x0,0x0,0x0,0x0,0x0,0x0,0x0,0x0,0x0  
};

// Please use a level shifter (ex. 74HC4050) 
//  if you're using a 5V Arduino
// pin 7 - Serial clock out (SCLK)
// pin 6 - Serial data out (DIN)
// pin 5 - Data/Command select (D/C)
// pin 4 - LCD chip select (CS)
// pin 3 - LCD reset (RST)

Adafruit_PCD8544 display = Adafruit_PCD8544(7, 6, 5, 4, 3);

void setup()   {
  Serial.begin(9600);
  display.begin();
  screensplash();
  display.setContrast(40);
  pinMode(2,OUTPUT);
  digitalWrite(2,HIGH);
  //analogWrite(2,5);  
}


void loop() {
  
  int sizeStream  = 28;
  int total_ram   = 0;
  char stream[sizeStream];
  display.clearDisplay();
  display.setTextSize(1);
  display.setCursor(0,0);
  if(Serial.available()){
  //if(1){
    delay(100);  //proporciona cierta "estabilidad" a la lectura de datos
    Serial.readBytes(stream, sizeStream);
    Serial.flush();  //muy importante borrar lo que haya en el puerto
    
    //display.setTextSize(1);
    monitorBase();
    display.setCursor(4,0);
    display.println("===Ardutop===");
    write_promedio(
                  stream[0],  stream[1],  stream[2], 
                  stream[3],  stream[4],  stream[5],
                  stream[6],  stream[7],  stream[8],
                  stream[9],  stream[10], stream[11]
                  );
    
    
    printCpuPercent(35, 16, stream[0],  stream[1],  stream[2], 16, 1);

    printCpuPercent(35, 24, stream[3],  stream[4],  stream[5], 24, 1);

    printCpuPercent(35, 16, stream[6],  stream[7],  stream[8], 16, 0);

    printCpuPercent(35, 24, stream[9],  stream[10], stream[11], 24, 0);

    printMem(30, 32, stream[12], stream[13], stream[14], stream[15]);
    printMem(60, 32, stream[24], stream[25], stream[26], stream[27]);

    draw_mem_bar(
    stream[12], stream[13], stream[14], stream[15], 
    stream[16], stream[17], stream[18], stream[19], 
    stream[20], stream[21], stream[22], stream[23]);

    display.display();
    Serial.end();    
    Serial.begin(9600);
    //delay(1000);
    Serial.flush();  //muy importante borrar lo que est@eacute en el puerto
  }
}

void write_promedio(char core_a1, char core_a2, char core_a3,
                    char core_b1, char core_b2, char core_b3,
                    char core_c1, char core_c2, char core_c3,
                    char core_d1, char core_d2, char core_d3){
  //display.setCursor(60, 0);
  /// algo
  char core_a[] = {core_a1, core_a2, core_a3, '\0'};
  char core_b[] = {core_b1, core_b2, core_b3, '\0'};
  char core_c[] = {core_c1, core_c2, core_c3, '\0'};
  char core_d[] = {core_d1, core_d2, core_d3, '\0'};
  
  int a = atoi(core_a);
  int b = atoi(core_b);
  int c = atoi(core_c);
  int d = atoi(core_d);
  
  int prom = (a+b+c+d)/4;
  display.setCursor(0,8);
  display.println("AVG:");
  if(prom<100){
    if(prom<10){
      display.setCursor(33,8);
    }else{
      display.setCursor(27,8);
    }
  }else{
    display.setCursor(21,8);
  }
  display.println(prom);
  int x = prom * 0.32;
  display.drawRect(50, 8, 32, 7, BLACK);
  display.fillRect(51, 9,  x, 6, BLACK);  
}

void draw_mem_bar(
char u1, char u2, char u3, char u4, 
char f1, char f2, char f3, char f4, 
char b1, char b2, char b3, char b4){

  char buf_used_real_ram[] = {
    u1, u2, u3, u4, '\0'  };
  char buf_free_ram[]      = {
    f1, f2, f3, f4, '\0'  };
  char buf_buffer_ram[]    = {
    b1, b2, b3, b4, '\0'  };

  int used_real_ram = atoi(buf_used_real_ram);
  int buffer_ram    = atoi(buf_buffer_ram);
  int free_ram      = atoi(buf_free_ram);

  int total_ram = used_real_ram + buffer_ram + free_ram;
  int punto = total_ram/82;

  display.drawRect(0, 40, 84, 8, BLACK); //marco de la barra

  //barra memoria usada:
  used_real_ram = used_real_ram/punto;
  display.fillRect(1, 41,  used_real_ram, 7, BLACK);

  //buffer memoria ram:
  buffer_ram = buffer_ram/punto;

  draw_dotted_bar(used_real_ram+1, 41, buffer_ram);

}

void draw_dotted_bar(int x, int y, int limit){
  for(int i=0; i<6; i++){
    if(i%2==0){
      draw_dotted_line(x, y+i, limit);
    }
    else{
      draw_dotted_line(x-1, y+i, limit);
    }
  }
}

void draw_dotted_line(int x, int y, int limit){
  for(int i=0; i<=limit; i++){
    if(i%2==0){
      display.drawPixel(x+i, y, BLACK);
    }
    else{
      display.drawPixel(x+i, y, WHITE);
    }
  }
}


void screensplash(){
  int b = 1;
  display.clearDisplay();
  display.drawBitmap(0, 0, idun, 84, 48, BLACK);
  display.display();
  delay(500);
  display.clearDisplay();
}

void printCpuPercent(int x, int y, char b1, char b2, char b3, int inicio_barra, int cpu){
  char buffer[] = {
    b1, b2, b3, '\0'  };
  display.setTextSize(1);
  int b = atoi(buffer);
  if(b <100){
    if(b <10){
      buffer[0] = ' ';
      buffer[1] = ' ';
    }
    else{
      buffer[0] = ' ';
    }
  }
  b = b/5;
  //dibujar 4 barras
  int in=0;
  if(cpu==1)
    in=20;
  else
    in=60;
  
  for(int i=0; i<1; i++){
    display.setCursor(in-18, inicio_barra);
    display.println(buffer);
    display.fillRect(in+1, inicio_barra,  b, 7, BLACK);
    display.drawRect(in, inicio_barra, 22, 7, BLACK); //marco de la barra
    in+=30;
  }
  
  
}

void printMem(int x, int y, char b1, char b2, char b3, char b4){
  char buffer[] = {
    b1, b2, b3, b4, '\0'  };
  display.setTextSize(1);
  display.setCursor(x, y);
  int b = atoi(buffer);
  if(b < 1000){
    if(b < 100){
      if(b < 10){
        buffer[0] = ' ';
        buffer[1] = ' ';
        buffer[2] = ' ';
      }
      else{
        buffer[0] = ' ';
        buffer[1] = ' ';
      }
    }
    else{
      buffer[0] = ' ';
    }
  }
  display.println(buffer);
}

void monitorBase(){
  display.clearDisplay();
  display.setTextSize(1);
  display.setCursor(0, 0);
  display.println("\n       %\n\n\nRAM :    /");
  //display.display();
}

